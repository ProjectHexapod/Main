;  Generated by PSoC Designer 5.2.2401
;
; AnalogColumn_InputMUX_0 address and mask equates
AnalogColumn_InputMUX_0_Data_ADDR:	equ	0h
AnalogColumn_InputMUX_0_DriveMode_0_ADDR:	equ	100h
AnalogColumn_InputMUX_0_DriveMode_1_ADDR:	equ	101h
AnalogColumn_InputMUX_0_DriveMode_2_ADDR:	equ	3h
AnalogColumn_InputMUX_0_GlobalSelect_ADDR:	equ	2h
AnalogColumn_InputMUX_0_IntCtrl_0_ADDR:	equ	102h
AnalogColumn_InputMUX_0_IntCtrl_1_ADDR:	equ	103h
AnalogColumn_InputMUX_0_IntEn_ADDR:	equ	1h
AnalogColumn_InputMUX_0_MASK:	equ	2h
; AnalogOutBuf_1 address and mask equates
AnalogOutBuf_1_Data_ADDR:	equ	0h
AnalogOutBuf_1_DriveMode_0_ADDR:	equ	100h
AnalogOutBuf_1_DriveMode_1_ADDR:	equ	101h
AnalogOutBuf_1_DriveMode_2_ADDR:	equ	3h
AnalogOutBuf_1_GlobalSelect_ADDR:	equ	2h
AnalogOutBuf_1_IntCtrl_0_ADDR:	equ	102h
AnalogOutBuf_1_IntCtrl_1_ADDR:	equ	103h
AnalogOutBuf_1_IntEn_ADDR:	equ	1h
AnalogOutBuf_1_MASK:	equ	20h
