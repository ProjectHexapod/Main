;;*****************************************************************************
;;*****************************************************************************
;;  FILENAME: Counter8.inc
;;   Version: 2.60, Updated on 2011/6/28 at 6:8:43
;;  Generated by PSoC Designer 5.1.2306
;;
;;  DESCRIPTION: Assembler declarations for the Counter8 user module interface
;;-----------------------------------------------------------------------------
;;  Copyright (c) Cypress Semiconductor 2011. All Rights Reserved.
;;*****************************************************************************
;;*****************************************************************************

include "m8c.inc"


;--------------------------------------------------
; Constants for Counter8 API's.
;--------------------------------------------------

Counter8_CONTROL_REG_START_BIT:            equ 0x01    ; Control register start bit
Counter8_INT_REG:                          equ 0x0e1
Counter8_INT_MASK:                         equ 0x01


;--------------------------------------------------
; Constants for Counter8 user defined values
;--------------------------------------------------

Counter8_PERIOD:                           equ 0x50
Counter8_COMPARE_VALUE:                    equ 0x00


;--------------------------------------------------
; Register Address Constants for Counter8
;--------------------------------------------------

Counter8_COUNTER_REG:                  equ 0x20   ; DR0 Counter register
Counter8_PERIOD_REG:                   equ 0x21   ; DR1 Period register
Counter8_COMPARE_REG:                  equ 0x22   ; DR2 CompareValue register
Counter8_CONTROL_REG:                  equ 0x23   ; Control register
Counter8_FUNC_REG:                     equ 0x20   ; Function register
Counter8_INPUT_REG:                    equ 0x21   ; Input register
Counter8_OUTPUT_REG:                   equ 0x22   ; Output register


;--------------------------------------------------
; Counter8 Macro 'Functions'
;--------------------------------------------------

   macro Counter8_Start_M
   or    reg[Counter8_CONTROL_REG],  Counter8_CONTROL_REG_START_BIT
   endm

   macro Counter8_Stop_M
   and   reg[Counter8_CONTROL_REG], ~Counter8_CONTROL_REG_START_BIT
   endm

   macro Counter8_EnableInt_M
   M8C_EnableIntMask Counter8_INT_REG, Counter8_INT_MASK
   endm

   macro Counter8_DisableInt_M
   M8C_DisableIntMask Counter8_INT_REG, Counter8_INT_MASK
   endm


; end of file Counter8.inc
