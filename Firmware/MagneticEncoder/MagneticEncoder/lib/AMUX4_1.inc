;;*****************************************************************************
;;*****************************************************************************
;;  FILENAME:   AMUX4_1.inc
;;  Version: 1.4, Updated on 2011/9/2 at 9:38:1
;;  Generated by PSoC Designer 5.2.2551
;;
;;  DESCRIPTION:  Assembler declarations for the MUX4 user module interface.
;;-----------------------------------------------------------------------------
;;  Copyright (c) Cypress Semiconductor 2011. All Rights Reserved.
;;*****************************************************************************
;;*****************************************************************************

;--------------------------------------------------
; Constants for AMUX4_1 API's.
;--------------------------------------------------
AMUX4_1_MUX_COL:             equ 0h
AMUX4_1_COL_COUNT:           equ (0h & 80h)
AMUX4_1_MUX_MASK:            equ (03 << (0h<<1))

AMUX4_1_PORT0_0:                  equ 0h
AMUX4_1_PORT0_2:                  equ 1h
AMUX4_1_PORT0_4:                  equ 2h
AMUX4_1_PORT0_6:                  equ 3h

AMUX4_1_PORT0_1:                  equ 0h
AMUX4_1_PORT0_3:                  equ 1h
AMUX4_1_PORT0_5:                  equ 2h
AMUX4_1_PORT0_7:                  equ 3h

; end of file AMUX4_1.inc
