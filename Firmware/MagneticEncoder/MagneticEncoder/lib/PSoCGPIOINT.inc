;  Generated by PSoC Designer 5.1.2306
;
; UART_TX address and mask equates
UART_TX_Data_ADDR:	equ	0h
UART_TX_DriveMode_0_ADDR:	equ	100h
UART_TX_DriveMode_1_ADDR:	equ	101h
UART_TX_DriveMode_2_ADDR:	equ	3h
UART_TX_GlobalSelect_ADDR:	equ	2h
UART_TX_IntCtrl_0_ADDR:	equ	102h
UART_TX_IntCtrl_1_ADDR:	equ	103h
UART_TX_IntEn_ADDR:	equ	1h
UART_TX_MASK:	equ	1h
; ADC_SINN address and mask equates
ADC_SINN_Data_ADDR:	equ	0h
ADC_SINN_DriveMode_0_ADDR:	equ	100h
ADC_SINN_DriveMode_1_ADDR:	equ	101h
ADC_SINN_DriveMode_2_ADDR:	equ	3h
ADC_SINN_GlobalSelect_ADDR:	equ	2h
ADC_SINN_IntCtrl_0_ADDR:	equ	102h
ADC_SINN_IntCtrl_1_ADDR:	equ	103h
ADC_SINN_IntEn_ADDR:	equ	1h
ADC_SINN_MASK:	equ	2h
; PWM2 address and mask equates
PWM2_Data_ADDR:	equ	0h
PWM2_DriveMode_0_ADDR:	equ	100h
PWM2_DriveMode_1_ADDR:	equ	101h
PWM2_DriveMode_2_ADDR:	equ	3h
PWM2_GlobalSelect_ADDR:	equ	2h
PWM2_IntCtrl_0_ADDR:	equ	102h
PWM2_IntCtrl_1_ADDR:	equ	103h
PWM2_IntEn_ADDR:	equ	1h
PWM2_MASK:	equ	8h
; PWM1 address and mask equates
PWM1_Data_ADDR:	equ	0h
PWM1_DriveMode_0_ADDR:	equ	100h
PWM1_DriveMode_1_ADDR:	equ	101h
PWM1_DriveMode_2_ADDR:	equ	3h
PWM1_GlobalSelect_ADDR:	equ	2h
PWM1_IntCtrl_0_ADDR:	equ	102h
PWM1_IntCtrl_1_ADDR:	equ	103h
PWM1_IntEn_ADDR:	equ	1h
PWM1_MASK:	equ	20h
; PWM0 address and mask equates
PWM0_Data_ADDR:	equ	0h
PWM0_DriveMode_0_ADDR:	equ	100h
PWM0_DriveMode_1_ADDR:	equ	101h
PWM0_DriveMode_2_ADDR:	equ	3h
PWM0_GlobalSelect_ADDR:	equ	2h
PWM0_IntCtrl_0_ADDR:	equ	102h
PWM0_IntCtrl_1_ADDR:	equ	103h
PWM0_IntEn_ADDR:	equ	1h
PWM0_MASK:	equ	80h
; SSI_CS address and mask equates
SSI_CS_Data_ADDR:	equ	4h
SSI_CS_DriveMode_0_ADDR:	equ	104h
SSI_CS_DriveMode_1_ADDR:	equ	105h
SSI_CS_DriveMode_2_ADDR:	equ	7h
SSI_CS_GlobalSelect_ADDR:	equ	6h
SSI_CS_IntCtrl_0_ADDR:	equ	106h
SSI_CS_IntCtrl_1_ADDR:	equ	107h
SSI_CS_IntEn_ADDR:	equ	5h
SSI_CS_MASK:	equ	8h
; SSI_DCLK address and mask equates
SSI_DCLK_Data_ADDR:	equ	4h
SSI_DCLK_DriveMode_0_ADDR:	equ	104h
SSI_DCLK_DriveMode_1_ADDR:	equ	105h
SSI_DCLK_DriveMode_2_ADDR:	equ	7h
SSI_DCLK_GlobalSelect_ADDR:	equ	6h
SSI_DCLK_IntCtrl_0_ADDR:	equ	106h
SSI_DCLK_IntCtrl_1_ADDR:	equ	107h
SSI_DCLK_IntEn_ADDR:	equ	5h
SSI_DCLK_MASK:	equ	20h
; SSI_DIO address and mask equates
SSI_DIO_Data_ADDR:	equ	4h
SSI_DIO_DriveMode_0_ADDR:	equ	104h
SSI_DIO_DriveMode_1_ADDR:	equ	105h
SSI_DIO_DriveMode_2_ADDR:	equ	7h
SSI_DIO_GlobalSelect_ADDR:	equ	6h
SSI_DIO_IntCtrl_0_ADDR:	equ	106h
SSI_DIO_IntCtrl_1_ADDR:	equ	107h
SSI_DIO_IntEn_ADDR:	equ	5h
SSI_DIO_MASK:	equ	80h
; PWM5 address and mask equates
PWM5_Data_ADDR:	equ	8h
PWM5_DriveMode_0_ADDR:	equ	108h
PWM5_DriveMode_1_ADDR:	equ	109h
PWM5_DriveMode_2_ADDR:	equ	bh
PWM5_GlobalSelect_ADDR:	equ	ah
PWM5_IntCtrl_0_ADDR:	equ	10ah
PWM5_IntCtrl_1_ADDR:	equ	10bh
PWM5_IntEn_ADDR:	equ	9h
PWM5_MASK:	equ	20h
; PWM4 address and mask equates
PWM4_Data_ADDR:	equ	8h
PWM4_DriveMode_0_ADDR:	equ	108h
PWM4_DriveMode_1_ADDR:	equ	109h
PWM4_DriveMode_2_ADDR:	equ	bh
PWM4_GlobalSelect_ADDR:	equ	ah
PWM4_IntCtrl_0_ADDR:	equ	10ah
PWM4_IntCtrl_1_ADDR:	equ	10bh
PWM4_IntEn_ADDR:	equ	9h
PWM4_MASK:	equ	80h
