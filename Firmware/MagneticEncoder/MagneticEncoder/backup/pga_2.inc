;;*****************************************************************************
;;*****************************************************************************
;;  FILENAME:   PGA_2.inc  ( PGA )
;;  Version: 3.2, Updated on 2011/6/28 at 6:9:49
;;  Generated by PSoC Designer 5.1.2306
;;
;;  DESCRIPTION:  Assembler declarations for the PGA user module interface.
;;-----------------------------------------------------------------------------
;;  Copyright (c) Cypress Semiconductor 2011. All Rights Reserved.
;;*****************************************************************************
;;*****************************************************************************

;--------------------------------------------------
; Constants for PGA_2 API's.
;--------------------------------------------------

PGA_2_OFF:         equ 0
PGA_2_LOWPOWER:    equ 1
PGA_2_MEDPOWER:    equ 2
PGA_2_HIGHPOWER:   equ 3

PGA_2_G48_0:       equ 0Ch
PGA_2_G24_0:       equ 1Ch
PGA_2_G16_0:       equ 08h
PGA_2_G8_00:       equ 18h
PGA_2_G5_33:       equ 28h
PGA_2_G4_00:       equ 38h
PGA_2_G3_20:       equ 48h
PGA_2_G2_67:       equ 58h
PGA_2_G2_27:       equ 68h
PGA_2_G2_00:       equ 78h
PGA_2_G1_78:       equ 88h
PGA_2_G1_60:       equ 98h
PGA_2_G1_46:       equ A8h
PGA_2_G1_33:       equ B8h
PGA_2_G1_23:       equ C8h
PGA_2_G1_14:       equ D8h
PGA_2_G1_06:       equ E8h
PGA_2_G1_00:       equ F8h
PGA_2_G0_93:       equ E0h
PGA_2_G0_87:       equ D0h
PGA_2_G0_81:       equ C0h
PGA_2_G0_75:       equ B0h
PGA_2_G0_68:       equ A0h
PGA_2_G0_62:       equ 90h
PGA_2_G0_56:       equ 80h
PGA_2_G0_50:       equ 70h
PGA_2_G0_43:       equ 60h
PGA_2_G0_37:       equ 50h
PGA_2_G0_31:       equ 40h
PGA_2_G0_25:       equ 30h
PGA_2_G0_18:       equ 20h
PGA_2_G0_12:       equ 10h
PGA_2_G0_06:       equ 00h

PGA_2_AGNDBUFAPI:  equ 0

;--------------------------------------------------
; Register Address Constants used by PGA_2
;--------------------------------------------------
PGA_2_GAIN_CR0: equ 75h
PGA_2_GAIN_CR1: equ 76h
PGA_2_GAIN_CR2: equ 77h
PGA_2_GAIN_CR3: equ 74h

