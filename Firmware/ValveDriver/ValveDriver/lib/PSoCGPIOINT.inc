;  Generated by PSoC Designer 5.2.2551
;
; PWM3 address and mask equates
PWM3_Data_ADDR:	equ	0h
PWM3_DriveMode_0_ADDR:	equ	100h
PWM3_DriveMode_1_ADDR:	equ	101h
PWM3_DriveMode_2_ADDR:	equ	3h
PWM3_GlobalSelect_ADDR:	equ	2h
PWM3_IntCtrl_0_ADDR:	equ	102h
PWM3_IntCtrl_1_ADDR:	equ	103h
PWM3_IntEn_ADDR:	equ	1h
PWM3_MASK:	equ	2h
; PWM2 address and mask equates
PWM2_Data_ADDR:	equ	0h
PWM2_DriveMode_0_ADDR:	equ	100h
PWM2_DriveMode_1_ADDR:	equ	101h
PWM2_DriveMode_2_ADDR:	equ	3h
PWM2_GlobalSelect_ADDR:	equ	2h
PWM2_IntCtrl_0_ADDR:	equ	102h
PWM2_IntCtrl_1_ADDR:	equ	103h
PWM2_IntEn_ADDR:	equ	1h
PWM2_MASK:	equ	8h
; PWM1 address and mask equates
PWM1_Data_ADDR:	equ	0h
PWM1_DriveMode_0_ADDR:	equ	100h
PWM1_DriveMode_1_ADDR:	equ	101h
PWM1_DriveMode_2_ADDR:	equ	3h
PWM1_GlobalSelect_ADDR:	equ	2h
PWM1_IntCtrl_0_ADDR:	equ	102h
PWM1_IntCtrl_1_ADDR:	equ	103h
PWM1_IntEn_ADDR:	equ	1h
PWM1_MASK:	equ	20h
; PWM0 address and mask equates
PWM0_Data_ADDR:	equ	0h
PWM0_DriveMode_0_ADDR:	equ	100h
PWM0_DriveMode_1_ADDR:	equ	101h
PWM0_DriveMode_2_ADDR:	equ	3h
PWM0_GlobalSelect_ADDR:	equ	2h
PWM0_IntCtrl_0_ADDR:	equ	102h
PWM0_IntCtrl_1_ADDR:	equ	103h
PWM0_IntEn_ADDR:	equ	1h
PWM0_MASK:	equ	80h
; PWM5 address and mask equates
PWM5_Data_ADDR:	equ	8h
PWM5_DriveMode_0_ADDR:	equ	108h
PWM5_DriveMode_1_ADDR:	equ	109h
PWM5_DriveMode_2_ADDR:	equ	bh
PWM5_GlobalSelect_ADDR:	equ	ah
PWM5_IntCtrl_0_ADDR:	equ	10ah
PWM5_IntCtrl_1_ADDR:	equ	10bh
PWM5_IntEn_ADDR:	equ	9h
PWM5_MASK:	equ	20h
; PWM4 address and mask equates
PWM4_Data_ADDR:	equ	8h
PWM4_DriveMode_0_ADDR:	equ	108h
PWM4_DriveMode_1_ADDR:	equ	109h
PWM4_DriveMode_2_ADDR:	equ	bh
PWM4_GlobalSelect_ADDR:	equ	ah
PWM4_IntCtrl_0_ADDR:	equ	10ah
PWM4_IntCtrl_1_ADDR:	equ	10bh
PWM4_IntEn_ADDR:	equ	9h
PWM4_MASK:	equ	80h
