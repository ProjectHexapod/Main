;;*****************************************************************************
;;*****************************************************************************
;;  FILENAME: SleepTimer_1.inc
;;   Version: 1.0, Updated on 2012/3/2 at 9:15:13
;;  Generated by PSoC Designer 5.2.2551
;;
;;  DESCRIPTION: Assembler declarations for the SleepTimer user module interface
;;-----------------------------------------------------------------------------
;;  Copyright (c) Cypress Semiconductor 2012. All Rights Reserved.
;;*****************************************************************************
;;*****************************************************************************

include "m8c.inc"


;--------------------------------------------------
; Constants for SleepTimer_1 API's.
;--------------------------------------------------

SleepTimer_1_INT_REG:                      equ 0x0e0
SleepTimer_1_INT_MASK:                     equ 0x40

SleepTimer_1_TICK_CNTR_SIZE:                equ  1h

; Frequency of sleep timer interrupts
SleepTimer_1_1_HZ:                          equ 0x18
SleepTimer_1_8_HZ:                          equ 0x10
SleepTimer_1_64_HZ:                         equ 0x08
SleepTimer_1_512_HZ:                        equ 0x00
SleepTimer_1_CLOCK_MASK:                    equ 0x18

SleepTimer_1_FORCE_RELOAD:                  equ 0x01
SleepTimer_1_WAIT_RELOAD:                   equ 0x00
